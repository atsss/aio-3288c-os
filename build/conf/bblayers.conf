## build/conf/bblayers.conf
```bitbake
# POKY_BBLAYERS_CONF_VERSION is increased each time build/conf/bblayers.conf
# changes incompatibly
POKY_BBLAYERS_CONF_VERSION = "2"

BBPATH = "${TOPDIR}"
BBFILES ?= ""

BBLAYERS ?= " \
  /home/ats/projects/yocto/rockchip/layers/poky/meta \
  /home/ats/projects/yocto/rockchip/layers/poky/meta-poky \
  /home/ats/projects/yocto/rockchip/layers/poky/meta-yocto-bsp \
  /home/ats/projects/yocto/rockchip/layers/meta-arm/meta-arm-toolchain \
  /home/ats/projects/yocto/rockchip/layers/meta-arm/meta-arm \
  /home/ats/projects/yocto/rockchip/layers/meta-rockchip \
  "
```
